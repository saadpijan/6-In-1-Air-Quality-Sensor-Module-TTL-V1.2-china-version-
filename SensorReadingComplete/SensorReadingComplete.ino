#include <SoftwareSerial.h>

SoftwareSerial Sensor(2,3); // Software serial pin conection RX,TX
unsigned char Data[20]="";
 int FData[8]; // calculated data 
String Vale[]={"CO2 = ", "TVOC = ", "CH2O = ", "PM2.5 = ", "Hum = ", "Temp = ","PM10 = ",};
//char calData[8];
unsigned long lastTime = 0;
unsigned long timerDelay = 1000;
 
uint16_t crc16(unsigned char pushMsg[],int MsgLen);
char sensorReading();

/* CRC check table low bit */ unsigned char auchCRCLo [ ] = {
0x00, 0xC0, 0xC1, 0x01, 0xC3, 0x03, 0x02, 0xC2, 0xC6, 0x06, 0x07, 0xC7, 0x05, 0xC5, 0xC4,
0x04, 0xCC, 0x0C, 0x0D, 0xCD, 0x0F, 0xCF, 0xCE, 0x0E, 0x0A, 0xCA, 0xCB, 0x0B, 0xC9, 0x09,
0x08, 0xC8, 0xD8, 0x18, 0x19, 0xD9, 0x1B, 0xDB, 0xDA, 0x1A, 0x1E, 0xDE, 0xDF, 0x1F, 0xDD,
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0x44, 0x84, 0x85, 0x45, 0x87, 0x47, 0x46, 0x86, 0x82, 0x42, 0x43, 0x83, 0x41, 0x81, 0x80,
0x40
};

/*CRC check table high order */
unsigned char auchCRCHi [ ] = {
0x00, 0xC1, 0x81, 0x40, 0x01, 0xC0, 0x80, 0x41, 0x01, 0xC0, 0x80, 0x41, 0x00, 0xC1, 0x81,
0x40, 0x01, 0xC0, 0x80, 0x41, 0x00, 0xC1, 0x81, 0x40, 0x00, 0xC1, 0x81, 0x40, 0x01, 0xC0,
0x80, 0x41, 0x01, 0xC0, 0x80, 0x41 ,0x40, 0x81, 0x40 ,0xC1 ,0x00, 0xC1, 0x81, 0x40, 0x01,
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0x00, 0xC1, 0x81, 0x40, 0x01, 0xC0, 0x80, 0x41, 0x01, 0xC0, 0x80, 0x41, 0x00, 0xC1, 0x81, 
0x40
};

void setup() 
{
  Serial.begin(115200);
  Sensor.begin(9600);   // Sensor works on 9600 baud rate
}

void loop() 
{

 sensorReading();

 
}// void Loop END




char sensorReading()
{

 if (Sensor.available()>=19)
  {
        Serial.println("Start");
  Serial.println(millis());
  int x= Sensor.readBytes(Data,19);
      Serial.println("Bytes received: ");
  Serial.println(x);
      Serial.print("Data: ");
     for(int i=0; i<=x-1; i++)
     { 
      Serial.print(Data[i],HEX);
      Serial.print(",");
     }

   if ( int(Data[0])==1 && int(Data[1])==3 && int(Data[2])==14)
   {
      // checking CRC
       uint16_t calculated_CRC,checkSum;
       checkSum=(Data[18] << 8 | Data[17]); // creating 16bit value
       calculated_CRC = crc16(Data, 14);
//         Serial.print(" Calculated CRC:  ");    
//         Serial.print( calculated_CRC, HEX );
//         Serial.print(" Recived CheckSum:  ");    
//         Serial.print(checkSum,HEX );
//         Serial.println( calculated_CRC == checkSum ? " -- passed." : " -- error.");
    
/// **************calculating and displaying calcuated data************//
        //"CO2":
           FData[0]=(Data[3]*256)+ Data[4];
       // "TVOC":
           FData[1] = ((Data[5]*256)+ Data[6])/10.0; 
       // "CH2O":
           FData[2] = ((Data[7]*256)+ Data[8])/10.0; 
      // "PM2.5":
          FData[3]=(Data[9]*256)+ Data[10];  
      // "Humidity":
            int Srh= (Data[11]*256)+ Data[12];
           FData[4]=(119*Srh)/pow(2,16);
      // "Temperature":
           int Stem= (Data[13]*256)+ Data[14];
           FData[5]=(128.87*Stem)/pow(2,16);
      //"PM10":
           FData[6]=(Data[15]*256)+ Data[16];

          for(int i=0; i<=7-1; i++)
           {
            Serial.print( Vale[i]);
            Serial.print(FData[i]);
            Serial.print(",");
           }
//         break;
      Serial.println("Stop");
  Serial.println(millis());
   }// finding start of data stream
   else
    Serial.print(" Did not Match Packet ");    
    Serial.println(".");
  }
//delay(100);
 
}// sensorReading END


uint16_t crc16(unsigned char pushMsg[], int MsgLen)
{
 unsigned int uIndex;
  uint8_t uchCRCLo= 0xff;
  uint8_t uchCRCHi= 0xff;
  unsigned int i = 0;;

while(MsgLen--)
{
  uIndex = (uchCRCLo ^ pushMsg[i]);
  uchCRCLo = uchCRCHi ^ auchCRCHi[uIndex];
  uchCRCHi = auchCRCLo[uIndex];
  i++;
}
    return (uchCRCHi << 8 | uchCRCLo) ;
}//crc16 END
